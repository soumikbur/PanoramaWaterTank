// ============================================================
// 06_LevelCalculation.ino
// ============================================================
// PURPOSE:
// Water Level Calculation and Calibration Table Interpolation Tab.
//
// RESPONSIBILITIES:
// 1. Maintain 201-point empirical calibration table (0..200 cm liquid height).
// 2. Perform piecewise linear interpolation of ADC offset against the calibration table.
// 3. Apply low-level deadband filtering (0.5 cm) and clamp height between 0 cm and 200 cm.
// 4. Provide linear fallback calculation if reading exceeds calibration lookup boundaries.
//
// USED BY:
// - SensorTask (computes liquid level from filtered ADC value)
// - BLE (SHOW_LEVEL command displays calculated height)
// ============================================================

// ============================================================
// CALIBRATION TABLE DATA STRUCTURE
// ============================================================
// Structure mapping relative ADC count offset (above A_air) to physical water level in centimeters.
struct CalibrationPoint {
  float adcOffset;
  float heightCm;
};

// 201-Point Empirical Calibration Lookup Table (0 cm to 200 cm in 1 cm increments).
const CalibrationPoint baseTable[] = {
  { 0.00, 0.00 }, { 16.80, 1.00 }, { 33.60, 2.00 }, { 50.40, 3.00 }, { 67.20, 4.00 },
  { 84.00, 5.00 }, { 100.80, 6.00 }, { 117.60, 7.00 }, { 134.40, 8.00 }, { 151.20, 9.00 },
  { 168.00, 10.00 }, { 184.80, 11.00 }, { 201.60, 12.00 }, { 218.40, 13.00 }, { 235.20, 14.00 },
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  { 3360.00, 200.00 }
};

// Total number of calibration entries in baseTable.
const int tableSize = sizeof(baseTable) / sizeof(baseTable[0]);

// ============================================================
// CALCULATE WATER LEVEL FROM ADC VALUE
// ============================================================
// Converts raw ADC value into physical water level in centimeters using calibrated voltage offset.
float getHeightFromADC(float adcValue)
{
    // Convert ADC value to voltage.
    float voltage = ads.computeVolts(adcValue);

    // Reject reading if voltage indicates sensor disconnection (< 0.25V).
    if (voltage < VOLTAGE_DISCONNECT_THRESHOLD)
    {
        return 0.0f;
    }

    // Compute voltage offset relative to calibrated zero baseline (A_air).
    float zeroVolts = ads.computeVolts(A_air);
    float voltageOffset = voltage - zeroVolts;

    // Return zero if pressure is at or below air baseline.
    if (voltageOffset <= 0.0f)
    {
        return 0.0f;
    }

    // Convert voltage offset to physical water height in cm:
    // (voltage - zeroVolts) / VOLTS_PER_CM
    float height = voltageOffset / VOLTS_PER_CM;

    // Apply 0.5 cm low-level deadband.
    if (height < DEADBAND_THRESHOLD)
        return 0.0f;

    if (height < 0.0f)
        height = 0.0f;

    if (height > SENSOR_FULL_SCALE_HEIGHT_CM)
        height = SENSOR_FULL_SCALE_HEIGHT_CM;

    return height;
}
